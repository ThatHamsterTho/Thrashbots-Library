#include <Arduino.h>
#include "NHDLCD.h"
#include "pins.h"

const char CharacterSet[96][5] = {
	{0x00, 0x00, 0x00, 0x00, 0x00}, // Space
	{0x00, 0x00, 0x4F, 0x00, 0x00}, // !
	{0x00, 0x07, 0x00, 0x07, 0x00}, // "
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	{0x08, 0x1C, 0x2A, 0x08, 0x08}  // <-
};

GLCD::GLCD() {}
GLCD::~GLCD() {}

void GLCD::init(){
	digitalWrite(NRST, LOW);           
  delay(100);                     
  digitalWrite(NRST, HIGH);           
  delay(100);

	comm_write(0xA0);   // ADC select
	comm_write(0xAE);   // Display OFF
	comm_write(0xC8);   // COM direction scan
	comm_write(0xA2);   // LCD bias set
	comm_write(0x2F);   // Power Control set
	comm_write(0x21);   // Resistor Ratio Set
	comm_write(0x81);   // Electronic Volume Command (set contrast) Double Btye: 1 of 2
	comm_write(0x20);   // Electronic Volume value (contrast value) Double Byte: 2 of 2
	comm_write(0xAF);   // Display ON
}

// Source: https://nhdforum.newhavendisplay.com/index.php?topic=11609.msg21076#msg21076
void GLCD::write(unsigned char d) {	
	for(unsigned int n=0; n<8; n++){
		if((d&0x80)==0x80)
			digitalWrite(SDI, HIGH);
		else
			digitalWrite(SDI, LOW);
		while(0); // nop
		d=(d<<1);
		digitalWrite(SCK, LOW);	while(0); // nop
		digitalWrite(SCK, HIGH);while(0); // nop
		digitalWrite(SCK, LOW);
	}
}

void GLCD::data_write(unsigned char d){
  Demux::Set(CSN::LCD);
	digitalWrite(REGS, HIGH);
	this->write(d);
  Demux::Clear();
}	

void GLCD::comm_write(unsigned char d){
  Demux::Set(CSN::LCD);
	digitalWrite(REGS, LOW);
	this->write(d);
  Demux::Clear();
}

void GLCD::write_char(char c){
  c -= 32;
  data_write(0x00);
  for(int i = 0; i < 5; i++){
    data_write((unsigned char)CharacterSet[(unsigned int)c][i]);
  }
  data_write(0x00);
}

void GLCD::SetCursorPos(unsigned char x, unsigned char y){
  y &= 0x03; // make sure that y is between 0 and 3
  x &= 0x7F; // make sure that x is between 0 and 127
  unsigned char page = 0xB0;
  comm_write(0x40);                           // Display start address + 0x40
  comm_write(page+y);
  comm_write(0x10 + (x & 0xF0>>4));           // column address upper 4 bits 0x10 + upper_x_offset
  comm_write(0x00 + (x & 0x0F   ));           // column address lower 4 bits 0x00 + lower_x_offset
}

void GLCD::DispPic(unsigned char *lcd_string)
{
  unsigned char page = 0xB0;
  comm_write(0x40);                         // Display start address + 0x40
  for(unsigned int i = 0; i < 4; i++){      // 32pixel display / 8 pixels per page = 4 pages
    comm_write(page);                       // send page address
    comm_write(0x10);                       // column address upper 4 bits + 0x10
    comm_write(0x00);                       // column address lower 4 bits + 0x00
    for(unsigned int j = 0; j < 128; j++){  // 128 columns wide
      data_write(*lcd_string);              // send picture data
      lcd_string++;
    }
    page++;                                 // after 128 columns, go to next page
  } 
}

// debug to view all characters
void GLCD::DispCharSet(){
  for(int k = 0; k < 4; k++){
      for(int j = 0; j < 4; j++){
        SetCursorPos(0, j);
        for(int i = 0; i < 18; i++){
          if((' ' + i + (18 * (j+k)) < 128))
            write_char(' ' + i + (18 * (j+k)));
          else
            write_char(' ');
        }
      }
      delay(1000);
    }
}

void GLCD::ClearLCD()
{
  for(unsigned int i = 0 ; i < 4; i++){     // 32pixel display / 8 pixels per page = 4 pages
    SetCursorPos(0,i);
    for(unsigned int j = 0 ; j < 128; j++){ // 128 columns wide
      data_write(0x00);                     // send picture data
    }
  }
}
